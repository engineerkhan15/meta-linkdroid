## conf/machine/alien5.conf
```bitbake
#@TYPE: Machine
#@NAME: 
#@DESCRIPTION: Machine configuration for the Amiko Alien5

SOC_FAMILY = "AML905D"

require conf/machine/include/linkdroid.inc

KERNEL_DEVICETREE = "alien5.dtb"
```

## conf/machine/include/enigma2-setup.inc
```bitbake
PV_pn-enigma2 = "amlogic+git${SRCPV}"
PKGV_pn-enigma2 = "amlogic+git${GITPKGV}"

SRC_URI_pn-enigma2 = "git://github.com/PLi-metas/enigma2-openpli-amlogic.git;branch=develop;name=enigma2 git://github.com/PLi-metas/extra_rc_models.git;protocol=git;destsuffix=extra_rc_models;name=extrarcmodels"
```
